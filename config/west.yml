## config/west.yml
```yaml
manifest:
  defaults:
    revision: v0.3
  remotes:
    - name: zmkfirmware
      url-base: https://github.com/zmkfirmware
  projects:
    - name: zmk
      remote: zmkfirmware
      import: app/west.yml
    - name: zmk-keyboards-totem
      url: https://github.com/victorlucachi/zmk-keyboards-totem
      revision: main
      path: modules/zmk-keyboards-totem
  self:
    path: config
```
